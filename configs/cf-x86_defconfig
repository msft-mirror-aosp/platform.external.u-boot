## configs/cf-x86_defconfig
```kconfig
CONFIG_X86=y
CONFIG_SYS_TEXT_BASE=0xFFF00000
CONFIG_ENV_SIZE=0x1000
# CONFIG_DM_GPIO is not set
CONFIG_NR_DRAM_BANKS=8
# CONFIG_AHCI is not set
CONFIG_BUILD_ROM=y
CONFIG_ANDROID_BOOT_IMAGE=y
CONFIG_SYS_CONSOLE_INFO_QUIET=y
CONFIG_DISPLAY_BOARDINFO_LATE=y
CONFIG_ANDROID_BOOTLOADER=y
CONFIG_LAST_STAGE_INIT=y
CONFIG_ANDROID_AB=y
CONFIG_HUSH_PARSER=y
# CONFIG_CMD_BDI is not set
# CONFIG_CMD_CONSOLE is not set
CONFIG_CMD_BOOTZ=y
# CONFIG_BOOTM_NETBSD is not set
# CONFIG_BOOTM_PLAN9 is not set
# CONFIG_BOOTM_RTEMS is not set
# CONFIG_BOOTM_VXWORKS is not set
# CONFIG_CMD_ELF is not set
# CONFIG_CMD_FDT is not set
# CONFIG_CMD_GO is not set
# CONFIG_CMD_IMI is not set
# CONFIG_CMD_XIMG is not set
# CONFIG_CMD_MEMORY is not set
# CONFIG_CMD_DM is not set
CONFIG_CMD_GPT=y
# CONFIG_RANDOM_UUID is not set
# CONFIG_CMD_IO is not set
# CONFIG_CMD_LOADB is not set
# CONFIG_CMD_LOADS is not set
CONFIG_CMD_PART=y
CONFIG_CMD_READ=y
CONFIG_CMD_AB_SELECT=y
CONFIG_CMD_BOOT_ANDROID=y
CONFIG_CMD_DHCP=y
# CONFIG_CMD_NFS is not set
CONFIG_CMD_PING=y
# CONFIG_CMD_BLOCK_CACHE is not set
# CONFIG_CMD_GETTIME is not set
CONFIG_CMD_QFW=y
# CONFIG_CMD_IRQ is not set
CONFIG_PARTITION_TYPE_GUID=y
CONFIG_DEFAULT_DEVICE_TREE="qemu-x86_i440fx"
CONFIG_ENV_IS_IN_RAW_DISK=y
CONFIG_ENV_RAW_DISK_INTERFACE="virtio"
CONFIG_ENV_RAW_DISK_DEVICE_AND_PART="0:1"
CONFIG_REGMAP=y
CONFIG_SYSCON=y
CONFIG_DEVRES=y
# CONFIG_SCSI_AHCI is not set
CONFIG_CPU=y
# CONFIG_INPUT is not set
# CONFIG_DM_KEYBOARD is not set
# CONFIG_DM_MMC is not set
# CONFIG_NETDEVICES is not set
CONFIG_PCI_ENUM_ONLY=y
# CONFIG_X86_PCH7 is not set
# CONFIG_X86_PCH9 is not set
CONFIG_DM_RNG=y
# CONFIG_SCSI is not set
# CONFIG_DM_SCSI is not set
# CONFIG_USB is not set
# CONFIG_DM_VIDEO is not set
# CONFIG_SYS_WHITE_ON_BLACK is not set
# CONFIG_VIDEO_VESA is not set
# CONFIG_VIRTIO_NET is not set
CONFIG_VIRTIO_RNG=y
# CONFIG_GENERATE_SMBIOS_TABLE is not set
# CONFIG_EFI_LOADER is not set
```
